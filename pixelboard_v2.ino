#include <MemoryFree.h>
#include <Adafruit_GFX.h>   // Core graphics library
#include <RGBmatrixPanel.h> // Hardware-specific library

#define CLK 11
#define LAT A3
#define OE  9
#define A   A0
#define B   A1
#define C   A2

#define CMD_SIZE 512
#define MAX_ELEMENTS 24
#define DEBUG 0

//Esi
uint16_t logo1 [] = {
0x0000,0x0000,0x0000,0x0000,0x0000,0x0000,0x0000,0x0000,0x0000,0x0000,0x0000,0x0000,0x0000,0x0000,0x0000,0x0000,
0x0000,0x4385,0x6D47,0x75A7,0x7E08,0x7E08,0x7E08,0x7E08,0x7E08,0x7E08,0x7E08,0x7E08,0x75A7,0x5CA6,0x75E8,0x0000,
0x0000,0x13D0,0x6527,0x7DE8,0x7E08,0x7E08,0x7E08,0x7E08,0x7E08,0x7E08,0x7DE8,0x64C6,0x3AE4,0x5C66,0x7E08,0x0000,
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0x0000,0x0000,0x0000,0x0000,0x0000,0x0000,0x0000,0x0000,0x0000,0x0000,0x0000,0x0000,0x0000,0x0000,0x0000,0x0000  
};

//Scotia
uint16_t logo2 [] = {
0x0000,0x0000,0x0000,0x0000,0x0000,0x0000,0x0000,0x0000,0x0000,0x0000,0x0000,0x0000,0x0000,0x0000,0x0000,0x0000,
0x0000,0xC800,0xC800,0xC800,0xC800,0xC800,0xC000,0xC000,0xB800,0xC000,0xC000,0xC000,0xB800,0xC800,0xC800,0x0000,
0x0000,0xC800,0xC800,0xC800,0xC800,0xC000,0xC841,0xE410,0xEC10,0xE410,0xE410,0xE3EF,0xF575,0xDA28,0xC800,0x0000,
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0x0000,0x0000,0x0000,0x0000,0x0000,0x0000,0x0000,0x0000,0x0000,0x0000,0x0000,0x0000,0x0000,0x0000,0x0000,0x0000
};

//Esso
uint16_t logo3 [] = {
0x0000,0x0000,0x0000,0x0000,0x0000,0x0000,0x0000,0x0000,0x0000,0x0000,0x0000,0x0000,0x0000,0x0000,0x0000,0x0000,
0x0000,0x0000,0x0000,0x0000,0x0000,0x0000,0x0000,0x0000,0x0000,0x0000,0x0000,0x0000,0x0000,0x0000,0x0000,0x0000,
0x0000,0x0000,0x0000,0xFFDF,0xD6FD,0x95BA,0x64B8,0x4C57,0x4C57,0x64B8,0x8D9A,0xCEFD,0xF7DF,0xFFFF,0x0000,0x0000,
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0x0000,0x0000,0x0000,0x0000,0x0000,0x0000,0x0000,0x0000,0x0000,0x0000,0x0000,0x0000,0x0000,0x0000,0x0000,0x0000
};

//Sobeys
uint16_t logo4 [] = {
0x0000,0x0000,0x0000,0x0000,0x0000,0x0000,0x0000,0x0000,0x0000,0x0000,0xFFFF,0xAEF7,0x554E,0x2448,0x2448,0x0000,
0x0000,0x0000,0x0000,0x0000,0x0000,0x0000,0x0000,0x0000,0x0000,0xBEF9,0x344A,0x2448,0x2448,0x2448,0x2448,0x0000,
0x0000,0x0000,0x0000,0x0000,0x0000,0x0000,0x0000,0x0000,0x8DD3,0x2448,0x2448,0x2448,0x2448,0x2448,0x2448,0x0000,
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0x0000,0x2448,0x2448,0x44CA,0x8DD3,0xFFFF,0x0000,0x0000,0x0000,0x0000,0x0000,0x0000,0x0000,0x0000,0x0000,0x0000
};

//Arduino
uint16_t logo5 [] = {
0x0000,0x0000,0x0000,0x0000,0x03CF,0x04B3,0x04B3,0x04B3,0x04B3,0x04B3,0x04B3,0x03CF,0x0000,0x0000,0x0000,0x0000,
0x0000,0x0000,0x0000,0x04B3,0x04B3,0x04B3,0x04B3,0x04B3,0x04B3,0x04B3,0x04B3,0x04B3,0x04B3,0x0000,0x0000,0x0000,
0x0000,0x0000,0x04B3,0x04B3,0x04B3,0x04B3,0x04B3,0x04B3,0x04B3,0x04B3,0x04B3,0x04B3,0x04B3,0x04B3,0x0000,0x0000,
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0x0000,0x0000,0x0000,0x0000,0x03CF,0x04B3,0x04B3,0x04B3,0x04B3,0x04B3,0x04B3,0x03CF,0x0000,0x0000,0x0000,0x0000
};

//Pi
uint16_t logo6 [] = {
0x0000,0x0000,0x0000,0x0000,0x0000,0x0080,0x0020,0x0000,0x0000,0x0000,0x0020,0x0080,0x0020,0x0000,0x0000,0x0000,
0x0000,0x0000,0x0000,0x0920,0x4D00,0x5540,0x5560,0x33A0,0x0000,0x2AE0,0x5560,0x5540,0x4D20,0x1A00,0x0000,0x0000,
0x0000,0x0000,0x0000,0x08E0,0x5E00,0x5540,0x4480,0x55C0,0x11A0,0x5580,0x44A0,0x4D00,0x5E40,0x1A00,0x0000,0x0000,
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0x0000,0x0000,0x0000,0x0000,0x0000,0x0000,0x0000,0x0000,0x2000,0x0000,0x0000,0x0000,0x0000,0x0000,0x0000,0x0000
};

typedef struct {
  int x;
  int y;  
  uint16_t color;
  uint8_t textSize;
  boolean isPixmap;
  char *data;
  uint16_t *pixmap;
} screenElement ;

screenElement screen[MAX_ELEMENTS];
uint8_t screenElements=0;
int screenWidth=0;

RGBmatrixPanel matrix(A, B, C, CLK, LAT, OE, true);

int   scrollX   = matrix.width();
int32_t   previousTime = 0;

uint16_t  hue     = 0;
       
uint8_t   scrollSpeed = 25;

boolean doneScroll=true;

char  input[CMD_SIZE+1],
      command[CMD_SIZE+1],
      line[CMD_SIZE+1];  
;

int ipos=0;
  
void setup() {
  input[0], command[0] ='\0';
  Serial.begin(38400);
  matrix.begin();
  matrix.setTextWrap(false); // Allow text to run off right edge
}

void loop() {

  readCommand();
  if(doneScroll) {
    parseCommand();
  }
  if(screenElements>0) {
    updateScreen();
  }
//  printDebug(false,"loop");

}

boolean readCommand() {

  boolean commandComplete = false;
  
  if (Serial.available()) {
    char c = Serial.read();
    if ((c=='\n')||(c=='\r')) {
      strcpy(command,input);
      ipos=0;
      input[ipos]='\0';
      commandComplete = true ;
    } else {
      input[ipos++]=c;
      input[ipos]='\0';
      if (ipos==CMD_SIZE) ipos=0 ; //command to long. don't want to overrun the buffer;
    }
  }
  
  return(commandComplete);

}

boolean charTologo(char inChar, uint16_t **logo) {
  
  boolean rc=true;
  
  switch (inChar) {
    case '1':
      *logo=logo1;
      break;
    case '2':
      *logo=logo2;
      break;
    case '3':
      *logo=logo3;
      break;
    case '4':
      *logo=logo4;
      break;
    case '5':
      *logo=logo5;
      break;
    case '6':
      *logo=logo6;
      break;
    default:
      rc=false;
      break;
  }

  return(rc);
}

void parseCommand() {
  
  char cc = '\0';
  char *dataStart;
  int parseError=0;
  char color[] = "FFFFFF";  

  strcpy(line,command);

  uint8_t screenPos=0, linePos=0, lineMax=0, dataLen=0;
  
  screenElements=0;
  screenWidth=0;  
  lineMax=strlen(line);
  
  while ((line[linePos] != '\0')&&(!parseError)) {
    if ( (line[linePos] =='/') ){
      line[linePos]='\0';
      linePos++;
      cc=line[linePos];
      if (dataLen > 0) {
        screen[screenElements-1].data=dataStart;
        if (screen[screenElements-1].isPixmap) {
          if (!charTologo(screen[screenElements-1].data[0], &screen[screenElements-1].pixmap)) { 
              parseError = true;
              setScreen("bad logo index");
          }
          screenWidth=screenWidth+16;
        } else {
          if ( (screenElements > 1) && (screen[screenElements-1].x == screen[screenElements-2].x) ) {
            if ( strlen(screen[screenElements-1].data) > strlen(screen[screenElements-2].data) ) {
              screenWidth=screenWidth+( strlen(screen[screenElements-1].data) - strlen(screen[screenElements-2].data) )*(screen[screenElements-1].textSize*6);
            } 
          } else {
            screenWidth=screenWidth+strlen(screen[screenElements-1].data)*(screen[screenElements-1].textSize*6);
          }
        }
      }
      switch (cc) {
        case '0':
          dataLen = 0;
          screenElements++;
          screen[screenElements-1].color=hexStringtoColor("444444");
          screen[screenElements-1].x=screenWidth;
          screen[screenElements-1].y=0;
          screen[screenElements-1].textSize=2;
          screen[screenElements-1].isPixmap=false;  
          break;
        case '1':
          dataLen = 0;
          screenElements++;
          screen[screenElements-1].color=hexStringtoColor("444444");          
          if ( (screenElements > 1) && (screen[screenElements-2].textSize == 1) ) {
            screen[screenElements-1].x=screen[screenElements-2].x;
          } else {
            screen[screenElements-1].x=screenWidth;
          }
          screen[screenElements-1].y=0;
          screen[screenElements-1].textSize=1;
          screen[screenElements-1].isPixmap=false;  
          break;
        case '2':
          dataLen = 0;
          screenElements++;
          screen[screenElements-1].color=hexStringtoColor("444444");          
          if ( (screenElements > 1) && (screen[screenElements-2].textSize == 1) ) {
            screen[screenElements-1].x=screen[screenElements-2].x;
          } else {
            screen[screenElements-1].x=screenWidth;
          }
          screen[screenElements-1].y=8;
          screen[screenElements-1].textSize=1;
          screen[screenElements-1].isPixmap=false;  
          break;
        case '#':
          if ( linePos + 7 > lineMax ) {
            parseError = true;
            setScreen("bad color");
          } else {
            strncpy(color,&line[linePos+1],6);
            if (dataLen == 0) {
              screen[screenElements-1].color=hexStringtoColor(color);
            } else {
              dataLen = 0;
              screenElements++;
              screen[screenElements-1].color=hexStringtoColor(color);
              screen[screenElements-1].x=screenWidth;
              screen[screenElements-1].y=screen[screenElements-2].y;
              screen[screenElements-1].textSize=screen[screenElements-2].textSize;
              screen[screenElements-1].isPixmap=false;  
            }
            linePos=linePos+6;
          }
          break;
        case 'L':
        case 'l':        
          if ( linePos + 1 > lineMax ) {
            parseError = true;
            setScreen("no logo index");
          } else {
            dataLen = 1;
            screenElements++;
            screen[screenElements-1].color=0;
            screen[screenElements-1].x=screenWidth;
            screen[screenElements-1].y=0;
            screen[screenElements-1].textSize=2;
            screen[screenElements-1].isPixmap=true;
          }
          break;
        default:
          parseError = true;
          setScreen("bad command");
          break;
      }
      dataStart=&line[linePos+1];
    } else {
      dataLen++;
    }
    linePos++;
  }
  
  if ((! parseError)&&(screenElements)) {
    screen[screenElements-1].data=dataStart;
    if (screen[screenElements-1].isPixmap) {
      if (!charTologo(screen[screenElements-1].data[0], &screen[screenElements-1].pixmap)) { 
          parseError = true;
          setScreen("bad logo index");
      }
      screenWidth=screenWidth+16;
    } else {
      if ( (screenElements > 1) && (screen[screenElements-1].x == screen[screenElements-2].x) ) {
        if ( strlen(screen[screenElements-1].data) > strlen(screen[screenElements-2].data) ) {
          screenWidth=screenWidth+( strlen(screen[screenElements-1].data) - strlen(screen[screenElements-2].data) )*(screen[screenElements-1].textSize*6);
        } 
      } else {
        screenWidth=screenWidth+strlen(screen[screenElements-1].data)*(screen[screenElements-1].textSize*6);
      }
    }
  }
  
  if (DEBUG) {
    printDebug(true,"parsed");
    printScreen();
  }

}

void setScreen(char *message) {

  screenElements=1;
  screen[screenElements-1].x=0;
  screen[screenElements-1].y=0;
  screen[screenElements-1].textSize=1;
  screen[screenElements-1].color=hexStringtoColor("444444");
  screen[screenElements-1].isPixmap=false;  
  screen[screenElements-1].data=message;
  screenWidth=strlen(screen[screenElements-1].data)*(screen[screenElements-1].textSize*6);
  
}

void updateScreen() {
  scrollMessage();
}

void drawLogo(uint16_t *pixmap, int8_t x, int8_t y) {
  drawPixmap(pixmap, 16, 16, x, y);
}

void drawPixmap(uint16_t *pixmap, uint8_t width, uint8_t height, int8_t x, int8_t y) {

  uint8_t px, py;

  for(px=0;px<width;px++) {
    for(py=0;py<height;py++) {
      matrix.drawPixel(px+x,py+y,pixmap[px+py*width]);
    }  
  }  

}

uint16_t hexStringtoColor(char *instring) {

  uint8_t red = 0, grn = 0, blu = 0;
  char hexchar[]="FF";

  strncpy(hexchar, instring, 2);
  red=strtoul(hexchar,0,16);

  strncpy(hexchar, instring+2, 2);
  grn=strtoul(hexchar,0,16);
  
  strncpy(hexchar, instring+4, 2);
  blu=strtoul(hexchar,0,16);
  
  return(matrix.Color888(red,grn,blu));

}

void scrollMessage() {
  
  doneScroll=false;

  // Clear background
  matrix.fillScreen(0);

  if (DEBUG==2) Serial.println(scrollX);
  
  displayMessage(scrollX);

  // Move text left (w/wrap)
  if((--scrollX) < screenWidth * -1) {
    scrollX = matrix.width();
    doneScroll = true;
  }
  matrix.swapBuffers(false);
  // slow the scroll
  delay(scrollSpeed);

}

void displayMessage(int x) {

  // Rotate hue
  hue += 7;
  if(hue >= 1536) hue -= 1536;

  for (uint8_t i=0; i<screenElements; i++) {
    if (screen[i].isPixmap) {
      drawLogo(screen[i].pixmap, screen[i].x+x, screen[i].y);
    } else {
      matrix.setTextSize(screen[i].textSize);
      if (screen[i].color == 0) {
        matrix.setTextColor(matrix.ColorHSV(hue, 255, 255, true));
      } else {  
        matrix.setTextColor(screen[i].color);
      }
      matrix.setCursor(screen[i].x+x, screen[i].y);
      matrix.print(screen[i].data);
    }
  }

}

void printScreen() {

  if (screenElements || screenWidth) {
  
    Serial.print("screenElements: ");
    Serial.print(screenElements);
    Serial.print(" screenWidth:");
    Serial.println(screenWidth);  
    
    for (uint8_t i=0; i<screenElements; i++) {
      Serial.print("screenElement:");
      Serial.println(i);
      Serial.print("screen[screenElement].x:");
      Serial.println(screen[i].x);
      Serial.print("screen[screenElement].y:"); 
      Serial.println(screen[i].y); 
      Serial.print("screen[screenElement].color:");
      Serial.println(screen[i].color);
      Serial.print("screen[screenElement].textSize:");
      Serial.println(screen[i].textSize);
      Serial.print("screen[screenElement].isPixmap:");
      Serial.println(screen[i].isPixmap);
      Serial.print("screen[screenElement].data:");
      Serial.println(screen[i].data);
      Serial.print("command:");
      Serial.println(command);
    }
  }
}

void printDebug(uint8_t force, char * message) {

  if ( ( millis() > previousTime + 2000 ) || (force) ) {

    if (DEBUG) {

      Serial.print("# ");  
      Serial.print(message);        
      Serial.println(" #");  

      Serial.print("now=");
      Serial.print(millis());
      Serial.print(" freeMemory()=");
      Serial.println(freeMemory());

      Serial.println("#");  

    }
    previousTime = millis();
  }
}

